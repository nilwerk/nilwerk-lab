## projects/plant-monitor/firmware/main/Kconfig.projbuild
```kconfig
menu "Plant Monitor"

    choice PLANT_BOARD
        prompt "Board variant"
        default PLANT_BOARD_DEVKIT
        help
            DevKit = ESP32-C3-DevKitM-1 with breakouts (bench). Custom = the Plant Monitor PCB (see main/board.h).

        config PLANT_BOARD_DEVKIT
            bool "ESP32-C3-DevKitM-1 + AHT20 + BH1750 + analog capacitive probe"
        config PLANT_BOARD_V1_SUPERMINI
            bool "v1 perfboard: ESP32-C3 SuperMini + AHT20 + BH1750 + analog probe (v1/WIRING.md)"
        config PLANT_BOARD_CUSTOM
            bool "Custom PCB (soil probe via PCNT: not implemented yet)"
    endchoice

    config PLANT_SOIL_DRY_RAW
        int "Soil probe raw counts in dry air (calibration point, 12-bit)"
        default 2800
        range 0 4095
        help
            PLACEHOLDER, UNVERIFIED: no probe has been measured. Replace with the bench value (WO-firmware-4.F1).

    config PLANT_SOIL_WET_RAW
        int "Soil probe raw counts in water (calibration point, 12-bit)"
        default 1200
        range 0 4095
        help
            PLACEHOLDER, UNVERIFIED: no probe has been measured. Replace with the bench value (WO-firmware-4.F1).

    config PLANT_SIM_MOCK_SENSORS
        bool "SIMULATOR ONLY: mocked sensor values instead of I2C/ADC (QEMU, no hardware)"
        default n
        help
            MOCK, NOT SENSOR DATA. Replaces the real HAL (main/sim_mock_hal.c) with fixed values for AHT20, BH1750, soil ADC and battery ADC,
            so the Espressif QEMU ESP32-C3 can run the sensor drivers without sensors. Every boot prints a line starting `NWSIMMOCK`.
            Used only by the sdkconfig overlay sdkconfig.defaults.sim-qemu and tests/qemu_boot_check.sh. Never set this on a board build.

    config PLANT_BENCH_SLEEP_CYCLE
        bool "Bench app: after 5 readings, deep sleep 60 s, then repeat (NFR-12 IO3 check)"
        default y

    config PLANT_SETUP_FLOW
        bool "Run the BLE setup flow at boot (task 4.F2)"
        default y
        help
            Boot decision (first boot / button) and BLE provisioning (NimBLE, security 2) before the bench loop.
            Needs a per-unit security-2 salt and verifier in NVS namespace "nw_sec2" or BLE stays off (fail closed).
            NOT RUN ON HARDWARE.

    config PLANT_API_BASE_URL
        string "Cloud API base URL for POST /device-claim (https, no trailing slash)"
        default "https://api.invalid"
        help
            BUILD SETTING, NOT COMMITTED (A-082): the real nilwerk-cloud project API URL is given later by Arsany and must never be
            written into a tracked file. Set it locally: put the PLANT_API_BASE_URL line (the option name with a CONFIG_ prefix) in the git-ignored file
            sdkconfig.defaults.local, or use idf.py menuconfig (stored in the git-ignored sdkconfig). See v1/FIRMWARE-BENCH.md section 2.
            The default ".invalid" never resolves, so a claim ends as claim_failed/network. test/host/check_api_url_not_committed.py guards this.

    config PLANT_UPLOAD
        bool "Hourly upload to the cloud (task 4.F3 slice 3): Wi-Fi + SNTP + HTTPS POST /ingest"
        default n
        help
            OFF by default: the v1 bench build is unchanged. When on, each wake reads the sensors once, keeps the sample in an RTC ring buffer
            (96 samples = 24 h) and sleeps to the next 15-min boundary; about once an hour it joins Wi-Fi, syncs time (SNTP) and POSTs the buffer.
            Needs: a unit provisioned by the BLE setup flow (Wi-Fi credentials and device token in NVS namespace "nw_prov"; the v1 defaults switch the
            setup flow OFF, so build with CONFIG_PLANT_SETUP_FLOW=y), and PLANT_API_BASE_URL set to the real https URL (build setting, A-082).
            UNVERIFIED: compiled by CI only, never run on hardware.

    config PLANT_NTP_SERVER
        string "NTP server for the SNTP time sync (needed for sample timestamps)"
        default "pool.ntp.org"
        depends on PLANT_UPLOAD

    config PLANT_UPLOAD_NET_TIMEOUT_S
        int "Seconds to wait for the Wi-Fi join and, separately, for SNTP"
        default 20
        range 5 120
        depends on PLANT_UPLOAD
        help
            Radio-on time costs battery (NFR-01). [proposed], not measured.

    config PLANT_UPLOAD_HTTP_TIMEOUT_MS
        int "HTTPS request timeout in ms (connect + TLS + answer)"
        default 15000
        range 3000 60000
        depends on PLANT_UPLOAD

    config PLANT_FW_VERSION
        string "Firmware version string sent as fw in /device-claim (max 32 chars)"
        default "0.4.2-dev"

endmenu
```
